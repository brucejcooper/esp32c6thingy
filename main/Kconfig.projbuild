## sdkconfig.defaults
```kconfig
CONFIG_MBEDTLS_SSL_PROTO_DTLS=y
CONFIG_MBEDTLS_PSK_MODES=y
CONFIG_MBEDTLS_KEY_EXCHANGE_PSK=y
CONFIG_LWIP_NETBUF_RECVINFO=y
CONFIG_COAP_SERVER_SUPPORT=y
CONFIG_LWIP_IPV6_AUTOCONFIG=y
CONFIG_COAP_CLIENT_SUPPORT=y
CONFIG_EXAMPLE_COAP_MCAST_IPV4_V6=y

CONFIG_OPENTHREAD_ENABLED=y
CONFIG_OPENTHREAD_JOINER=y
CONFIG_MBEDTLS_ECJPAKE_C=y
CONFIG_MBEDTLS_KEY_EXCHANGE_ECJPAKE=y

CONFIG_OPENTHREAD_BORDER_ROUTER=n
CONFIG_OPENTHREAD_DNS64_CLIENT=y
CONFIG_LWIP_TCPIP_TASK_STACK_SIZE=4096
CONFIG_LWIP_IPV6_NUM_ADDRESSES=8
CONFIG_LWIP_MULTICAST_PING=y
CONFIG_LWIP_HOOK_IP6_SELECT_SRC_ADDR_CUSTOM=y
CONFIG_IEEE802154_ENABLED=y
CONFIG_MBEDTLS_CMAC_C=y
CONFIG_LIBSODIUM_USE_MBEDTLS_SHA=y


CONFIG_PARTITION_TABLE_CUSTOM=y
CONFIG_PARTITION_TABLE_CUSTOM_FILENAME="partitions.csv"
CONFIG_PARTITION_TABLE_FILENAME="partitions.csv"
CONFIG_PARTITION_TABLE_OFFSET=0x8000
CONFIG_PARTITION_TABLE_MD5=y


CONFIG_ESPTOOLPY_FLASHSIZE_8MB=y

CONFIG_ESP_TIMER_SUPPORTS_ISR_DISPATCH_METHOD=y

CONFIG_FREERTOS_HZ=100
```
